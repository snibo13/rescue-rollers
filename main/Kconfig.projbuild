## main/Kconfig.projbuild
```kconfig
menu "micro-ROS example-app settings"

    config MICRO_ROS_APP_STACK
        int "Stack the micro-ROS app (Bytes)"
        default 16000
        help
        Stack size in Bytes of the micro-ROS app

    config MICRO_ROS_APP_TASK_PRIO
        int "Priority of the micro-ROS app"
        default 5
        help
        Priority of micro-ros task higher value means higher priority
        
endmenu


menu "RESCUE Roller Configuration"
    config ROBOT_ID
        int "Robot ID"
        default 1
        help
        ID of the robot

    config ROBOT_SENSOR
        int "Robot Sensor"
        default 0
        help
        Sensor of the robot (0: None, 1: Flammable Gas, 2: mmWave Radar, 3: Camera, 4: CO2)

    config WHEEL_BASE
        int "Wheel Base (mm)"
        default 85
        help
        Distance between the two wheels of the robot
endmenu
```

## sdkconfig.defaults
```kconfig
CONFIG_ESP_MAIN_TASK_STACK_SIZE=3000
CONFIG_ESP_TASK_WDT=n

CONFIG_ESP_WIFI_SSID="Rescue Aid Society"
CONFIG_ESP_WIFI_PASSWORD="rescuerollers"
CONFIG_ESP_MAXIMUM_RETRY=5
# end of WiFi Configuration

CONFIG_MICRO_ROS_AGENT_IP="192.168.0.128"
CONFIG_MICRO_ROS_AGENT_PORT="8888"
# end of micro-ROS Settings
```
